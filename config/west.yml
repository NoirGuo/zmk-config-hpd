## config/west.yml
```yaml
manifest:
  remotes:
    - name: zmkfirmware
      url-base: https://github.com/zmkfirmware
    - name: antoinegs
      url-base: https://github.com/AntoineGS
    - name: englmaxi
      url-base: https://github.com/englmaxi
    - name: tokyo2006
      url-base: https://github.com/tokyo2006
  projects:
    - name: zmk
      remote: zmkfirmware
      revision: v0.3
      import: app/west.yml
    - name: zmk-pmw3610-driver
      remote: antoinegs
      revision: main
    - name: zmk-dongle-display
      remote: englmaxi
      revision: main
    - name: prospector-zmk-module                 # <--- and these
      remote: tokyo2006                          # <---
      revision: micro_spi2  
  self:
    path: config
```
